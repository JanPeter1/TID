## main/Kconfig.projbuild
```kconfig
menu "Texel Info Display"

choice TID_DISPLAY_BOARD
    prompt "Display board"
    default TID_BOARD_CYD if IDF_TARGET_ESP32
    default TID_BOARD_JC3248W535C if IDF_TARGET_ESP32S3

config TID_BOARD_CYD
    bool "ESP32-2432S028 CYD"
    depends on IDF_TARGET_ESP32

config TID_BOARD_JC3248W535C
    bool "Guition JC3248W535C"
    depends on IDF_TARGET_ESP32S3

endchoice

endmenu
```

## sdkconfig.defaults
```kconfig
CONFIG_IDF_TARGET="esp32"
CONFIG_ESPTOOLPY_FLASHSIZE_4MB=y
CONFIG_PARTITION_TABLE_CUSTOM=y
CONFIG_PARTITION_TABLE_CUSTOM_FILENAME="partitions.csv"
CONFIG_PARTITION_TABLE_OFFSET=0x8000
CONFIG_ESPTOOLPY_FLASHSIZE="4MB"
CONFIG_MBEDTLS_CERTIFICATE_BUNDLE=y
CONFIG_MBEDTLS_DEFAULT_CERTIFICATE_BUNDLE=y
CONFIG_MBEDTLS_SSL_IN_CONTENT_LEN=8192
CONFIG_MBEDTLS_DYNAMIC_BUFFER=y
CONFIG_ESP_HTTP_CLIENT_ENABLE_HTTPS=y
CONFIG_ESP_TLS_USING_MBEDTLS=y
CONFIG_ESP_WIFI_SOFTAP_SUPPORT=y
CONFIG_ESP_WIFI_STA_DISCONNECTED_PM_ENABLE=n
CONFIG_FREERTOS_HZ=1000
CONFIG_LWIP_TCPIP_TASK_STACK_SIZE=8192
CONFIG_COMPILER_STACK_CHECK_MODE_STRONG=y
CONFIG_HEAP_POISONING_LIGHT=y
CONFIG_LV_COLOR_DEPTH_16=y
CONFIG_LV_MEM_SIZE=65536
CONFIG_LV_FONT_MONTSERRAT_12=y
CONFIG_LV_FONT_MONTSERRAT_24=y
CONFIG_LV_USE_QRCODE=y
CONFIG_LV_USE_TJPGD=y
CONFIG_LV_TXT_ENC_UTF8=y
```
